## configs/buildroot_2019.02.2_defconfig
```kconfig
BR2_x86_64=y
BR2_WGET="wget -c --passive-ftp -nd -t 3"
BR2_KERNEL_HEADERS_CUSTOM_GIT=y
BR2_KERNEL_HEADERS_CUSTOM_REPO_URL="/labs/linux-lab/linux-stable"
BR2_KERNEL_HEADERS_CUSTOM_REPO_VERSION="v4.20"
BR2_TARGET_GENERIC_HOSTNAME="linux-lab"
BR2_TARGET_GENERIC_ISSUE="Welcome to Linux Lab"
BR2_PACKAGE_BUSYBOX_SHOW_OTHERS=y
BR2_PACKAGE_BASH=y
BR2_TARGET_ROOTFS_CPIO=y
BR2_TARGET_ROOTFS_CPIO_GZIP=y
# BR2_TARGET_ROOTFS_TAR is not set
# For wireless
# BR2_PACKAGE_WIRELESS_REGDB=y
```
